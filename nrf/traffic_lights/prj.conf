## CMakeLists.txt
```
cmake_minimum_required(VERSION 3.20.0)
find_package(Zephyr REQUIRED HINTS $ENV{ZEPHYR_BASE})

project(traffic_lights)

target_sources(app PRIVATE src/main.c)
target_sources(app PRIVATE src/ledctl.c)
target_sources(app PRIVATE src/buttons.c)
target_sources(app PRIVATE src/dispatcher.c)
target_sources(app PRIVATE src/mux.c)
target_sources(app PRIVATE src/debug.c)
```

## prj.conf
```kconfig
CONFIG_GPIO=y
CONFIG_HEAP_MEM_POOL_SIZE=1024
CONFIG_TIMING_FUNCTIONS=y
CONFIG_DEBUG=n
```

## src/main.c
```c
/* My goal is to get full grades in Embedded Programming courses, because it will help me
 * to better understand embedded systems programming and Zephyr RTOS, and possibly
 * open up career opportunities in embedded systems development in the future. I see
 * this skill as a valuable asset in the tech industry.
*/

#include <stdio.h>
#include <zephyr/kernel.h>
#include <zephyr/drivers/gpio.h>
#include <zephyr/timing/timing.h>

#include "ledctl.h"
#include "buttons.h"
#include "dispatcher.h"
#include "mux.h"
#include "debug.h"

int main(void)
{
    bool initval_debug = print_debug_messages;
    print_debug_messages = true;
    // Initialize timing timer and start it. Leaving this running does not actually cost anything for us
    timing_init();
    timing_start();

    timing_t start = timing_counter_get();

    if (!init_leds()) {
        return 0;
    }
    debug("Initialized leds");
    
    if (!init_buttons()) {
        return 0;
    }
    debug("Initialized buttons");
    
    if (!init_uart()) {
        return 0;
    }
    debug("Initialized uart");

    for (int i = 0; i < 3; i++) {
        k_sem_take(&threads_ready, K_FOREVER);
        debug("Sem: %d", i);
        k_msleep(100);
    }

    // Try to start the sequence until it starts. Do not block because signals are not
    // preserved if the receiver is not listening yet.
    debug("Trying to start a sequence");
    k_mutex_lock(&lmux, K_FOREVER);
    k_condvar_broadcast(&rsig);
    k_condvar_wait(&sig_ok, &lmux, K_FOREVER);
    k_mutex_unlock(&lmux);

    uint64_t elapsed = timing_cycles_to_ns(timing_counter_get() - start);
    debug("OK! Main thread done! Took: %lld ns", elapsed);

    print_debug_messages = initval_debug;
    return 0;
}
```

## src/buttons.c
```c
#include <zephyr/kernel.h>
#include <zephyr/drivers/gpio.h>

#include "buttons.h"
#include "ledctl.h"
#include "mux.h"
#include "debug.h"

// Manual drive button is button 0
#define MANUAL DT_ALIAS(sw0)
// Switch to color or turn current color off on manual drive
#define RED_TOGGLE DT_ALIAS(sw1)
#define YELLOW_TOGGLE DT_ALIAS(sw2)
#define GREEN_TOGGLE DT_ALIAS(sw3)
// Toggle blink yellow on manual drive
#define YBLINK_TOGGLE DT_ALIAS(sw4)

// Prevent noise and constant interruptions from button presses
#define DEBOUNCE_TIME_MS 200

K_TIMER_DEFINE(button_db, interrupt_enable, NULL);

// Bind manual drive state to button 0 and create a callback structure
static const struct gpio_dt_spec manual_button = GPIO_DT_SPEC_GET(MANUAL, gpios);
static struct gpio_callback manual_cb_data;

// Bind manual toggle color buttons to buttons 2, 3, 4 and 5 and create callback structures
static const struct gpio_dt_spec red_toggle = GPIO_DT_SPEC_GET(RED_TOGGLE, gpios);
static struct gpio_callback red_cb_data;
static const struct gpio_dt_spec yellow_toggle = GPIO_DT_SPEC_GET(YELLOW_TOGGLE, gpios);
static struct gpio_callback yellow_cb_data;
static const struct gpio_dt_spec green_toggle = GPIO_DT_SPEC_GET(GREEN_TOGGLE, gpios);
static struct gpio_callback green_cb_data;
static const struct gpio_dt_spec yblink_toggle = GPIO_DT_SPEC_GET(YBLINK_TOGGLE, gpios);
static struct gpio_callback yblink_cb_data;

static bool interrupt_enabled = true;

bool init_buttons(void)
{
    // Check that buttons are ready
    if (!gpio_is_ready_dt(&manual_button) || !gpio_is_ready_dt(&red_toggle) ||
    !gpio_is_ready_dt(&yellow_toggle) || !gpio_is_ready_dt(&green_toggle) ||
    !gpio_is_ready_dt(&yblink_toggle)) {
        debug("Error: Button device not ready\n");
        return false;
    }

    // Set led pins as output and buttons as input
	if (gpio_pin_configure_dt(&manual_button, GPIO_INPUT | GPIO_PULL_UP) < 0
        || gpio_pin_configure_dt(&red_toggle, GPIO_INPUT | GPIO_PULL_UP) < 0
        || gpio_pin_configure_dt(&yellow_toggle, GPIO_INPUT | GPIO_PULL_UP) < 0
        || gpio_pin_configure_dt(&green_toggle, GPIO_INPUT | GPIO_PULL_UP) < 0
        || gpio_pin_configure_dt(&yblink_toggle, GPIO_INPUT | GPIO_PULL_UP) < 0) {
        debug("Error: Failed to configure IO\n");
		return false;
	}

    // Finally configure the button to interrupt and..
    if (gpio_pin_interrupt_configure_dt(&manual_button, GPIO_INT_EDGE_TO_INACTIVE) < 0 ||
    gpio_pin_interrupt_configure_dt(&red_toggle, GPIO_INT_EDGE_TO_ACTIVE) < 0 ||
    gpio_pin_interrupt_configure_dt(&yellow_toggle, GPIO_INT_EDGE_TO_ACTIVE) < 0 ||
    gpio_pin_interrupt_configure_dt(&green_toggle, GPIO_INT_EDGE_TO_ACTIVE) < 0 ||
    gpio_pin_interrupt_configure_dt(&yblink_toggle, GPIO_INT_EDGE_TO_ACTIVE) < 0) {
        debug("Error: Failed to configure button interrupt\n");
        return false;
    }

    // ..add the interrupt handlers
    gpio_init_callback(&manual_cb_data, manual_isr, BIT(manual_button.pin));
    gpio_init_callback(&red_cb_data, red_toggle_isr, BIT(red_toggle.pin));
    gpio_init_callback(&yellow_cb_data, yellow_toggle_isr, BIT(yellow_toggle.pin));
    gpio_init_callback(&green_cb_data, green_toggle_isr, BIT(green_toggle.pin));
    gpio_init_callback(&yblink_cb_data, yblink_toggle_isr, BIT(yblink_toggle.pin));

    if (gpio_add_callback(manual_button.port, &manual_cb_data) < 0 ||
    gpio_add_callback(red_toggle.port, &red_cb_data) < 0 || 
    gpio_add_callback(yellow_toggle.port, &yellow_cb_data) < 0 ||
    gpio_add_callback(green_toggle.port, &green_cb_data) < 0 ||
    gpio_add_callback(yblink_toggle.port, &yblink_cb_data) < 0) {
        debug("Error: Failed to add button callback(s)\n");
        return false;
    }

    return true;
}

void interrupt_enable(void)
{
    interrupt_enabled = true;
    gpio_pin_interrupt_configure_dt(&manual_button, GPIO_INT_EDGE_TO_ACTIVE);

    if (paused) {
        // If we are in manual mode, we need to reconfigure the toggles
        gpio_pin_interrupt_configure_dt(&red_toggle, GPIO_INT_EDGE_TO_ACTIVE);
        gpio_pin_interrupt_configure_dt(&yellow_toggle, GPIO_INT_EDGE_TO_ACTIVE);
        gpio_pin_interrupt_configure_dt(&green_toggle, GPIO_INT_EDGE_TO_ACTIVE);
        gpio_pin_interrupt_configure_dt(&yblink_toggle, GPIO_INT_EDGE_TO_ACTIVE);
    }

    debug("Interrupts enabled\n");
}

void interrupt_disable(void)
{
    interrupt_enabled = false;
    gpio_pin_interrupt_configure_dt(&manual_button, GPIO_INT_DISABLE);
    gpio_pin_interrupt_configure_dt(&red_toggle, GPIO_INT_DISABLE);
    gpio_pin_interrupt_configure_dt(&yellow_toggle, GPIO_INT_DISABLE);
    gpio_pin_interrupt_configure_dt(&green_toggle, GPIO_INT_DISABLE);
    gpio_pin_interrupt_configure_dt(&yblink_toggle, GPIO_INT_DISABLE);
    k_timer_start(&button_db, K_MSEC(DEBOUNCE_TIME_MS), K_NO_WAIT);
}

void manual_isr(void)
{
    interrupt_disable();
    paused = !paused;

    // If we are pausing, save the current state and set state to MANUAL
    if (paused) {
        // Save the current color
        cont = color;
        state = Manual;
        debug("Manual control\n");
    // If we are unpausing, restore the saved state
    } else {
        if (k_mutex_lock(&lmux, K_NO_WAIT) == 0) {
            state = Auto;
            color = cont;

            switch (color) {
                case Red:
                    k_condvar_signal(&rsig);
                    break;
                case Yellow:
                    k_condvar_signal(&ysig);
                    break;
                default:
                    k_condvar_signal(&gsig);
                    break;
            }
        } else {
            debug("Try again. Mutex is busy\n");
        }

        k_mutex_unlock(&lmux);
    }
}

void red_toggle_isr(void)
{
    interrupt_disable();

    // Only do something if we are paused
    if (paused) {
        if (state == Blink) {
            state = Manual;
            debug("Toggling YELLOW BLINK OFF\n");
        }

        // Send signal to red task
        k_condvar_signal(&rsig);
        debug("Toggling RED\n");
    }
}

void yellow_toggle_isr(void)
{
    interrupt_disable();

    if (paused) {
        if (state == Blink) {
            state = Manual;
            debug("Toggling YELLOW BLINK OFF\n");
        }

        // Send signal to yellow task
        k_condvar_signal(&ysig);
        debug("Toggling YELLOW\n");
    }

}

void green_toggle_isr(void)
{
    interrupt_disable();

    if (paused) {
        if (state == Blink) {
            state = Manual;
            debug("Toggling YELLOW BLINK OFF\n");
        }
        
        // Send signal to green task
        k_condvar_signal(&gsig);
        debug("Toggling GREEN\n");
    }
}

void yblink_toggle_isr(void)
{
    interrupt_disable();

    if (paused) {
        // Toggle blinking yellow mode
        if (state != Blink) {
            state = Blink;
            debug("Toggling YELLOW BLINK ON\n");
        } else {
            state = Manual;
            debug("Toggling YELLOW BLINK OFF\n");
        }
    }

    // Send signal to yellow task
    k_condvar_signal(&ysig);
}
```

## src/buttons.h
```c
#ifndef BUTTONS_H
#define BUTTONS_H

// Interrupt callback for the buttons
void manual_isr(void);
void red_toggle_isr(void);
void yellow_toggle_isr(void);
void green_toggle_isr(void);
void yblink_toggle_isr(void);

// Helper functions and variable to enable an disable interrupts for pause button
// and to detect if the interrupts are enabled or disabled
void interrupt_enable(void); 
void interrupt_disable(void);

bool init_buttons(void);

#endif
```

## src/debug.c
```c
/** Yeah, I may have gone a little overboard with this debugger. The reason behind that is that I wanted to
 *  learn how to actually pass variable amount of arguments to other tasks, so that other tasks don't have
 *  to format the debug messages themselves and can just immediately carry on as usual.
 * 
 *  This is how this is supposed to work: A normal working thread calls debug function with some debug message and
 *  formatting variables, like any other formatting print function. This debug function quickly allocates memory
 *  from memory slabs for the fifo messages, and for the arguments from a dedicated slab.
 */

#include <zephyr/kernel.h>
#include <zephyr/timing/timing.h>

#include "debug.h"
#include "mux.h"

// Argument amount that can be stored in one memory slab block.
#define ARGS_PER_BLOCK 4
#define MAX_ARGS 4
// Block amount in one memory slab.
#define MEM_SLAB_BLOCKS 32

void debug_task(void *, void*, void *);

/* 
    Holds a tight, non-fragmentable memory block for debug messages. Each message may only be 128 characters long.
    There is room for 16 simultaneous messages in total. Use `k_mem_slab_alloc(&debug_messages, (void **)&fifodata, some_wait_time)`
    to allocate a slab block for a debug message. 
*/
struct k_mem_slab debug_messages;

/*
    FIFO queue for debug messages. Expects `struct debug_fifo_t` type data.
*/
struct k_fifo debug_fifo;

/*
    Store one single argument and point to next four argument block, which is unnlikely. Usually 4 is quite enough for any debug message.
*/
struct debug_t {
    const char *fmt;
    size_t argc;
    uintptr_t args[MAX_ARGS];
};

/* 
    Each debug fifo element holds a string pointer to arbitrary sized string that needs to be formatted.
*/
struct debug_fifo_t {
    void *fifo_reserved;
    struct debug_t dbg;
};

// Initialize statistics
struct statistics statistics = {
    .btns = {
        .button_manual_toggle = 0,
        .button_red_toggle = 0,
        .button_yellow_toggle = 0,
        .button_green_toggle = 0,
        .button_yellow_blink_toggle = 0
    },

    .leds = {
        .red.toggled = 0,
        .blue.toggled = 0
    },

    .threads = {
        .main = {
            .typical_signal_wait_time_ms = 0,
            .typical_runtime_ns = 0
        },

        .red = {
            .typical_signal_wait_time_ms = 0,
            .typical_runtime_ns = 0
        },

        .yellow = {
            .typical_signal_wait_time_ms = 0,
            .typical_runtime_ns = 0
        },

        .green = {
            .typical_signal_wait_time_ms = 0,
            .typical_runtime_ns = 0
        },
        
        .uart = {
            .typical_signal_wait_time_ms = 0,
            .typical_runtime_ns = 0
        },
        
        .dispatcher = {
            .typical_signal_wait_time_ms = 0,
            .typical_runtime_ns = 0
        },

        .debug = {
            .typical_signal_wait_time_ms = 0,
            .typical_runtime_ns = 0
        }
    }
};

volatile bool print_debug_messages = false;

K_FIFO_DEFINE(debug_fifo);
K_THREAD_DEFINE(debugth, 1024, debug_task, NULL, NULL, NULL, 10, 0, 0);
K_MEM_SLAB_DEFINE(debug_messages, sizeof(struct debug_t), MEM_SLAB_BLOCKS, 4);


void debug_task(void *, void *, void *) {
    struct debug_fifo_t *data;

    while (1) {
        // Check the fifo queue for available messages and parse them until none are left. Yield for a longer period after the queue has been
        // processed to give room for more important tasks.
        while ((data = k_fifo_get(&debug_fifo, K_NO_WAIT)) != NULL) {
            printk("DEBUG: ");
            switch (data->dbg.argc) {
                case 0:
                    printk(data->dbg.fmt);
                    break;
                case 1:
                    printk(data->dbg.fmt, data->dbg.args[0]);
                    break;
                case 2:
                    printk(data->dbg.fmt, data->dbg.args[0], data->dbg.args[1]);
                    break;
                case 3:
                    printk(data->dbg.fmt, data->dbg.args[0], data->dbg.args[1], data->dbg.args[2]);
                    break;
                case 4:
                    printk(data->dbg.fmt, data->dbg.args[0], data->dbg.args[1], data->dbg.args[2], data->dbg.args[3]);
                    break;
            }

            printk("\n");
            k_mem_slab_free(&debug_messages, data);
        }

        k_msleep(200);
    }
}

void schedule_printk(const char *fmt, size_t argc, uintptr_t *args) {
    struct debug_fifo_t *data;

    if (k_mem_slab_alloc(&debug_messages, (void **)&data, K_NO_WAIT) == 0) {
        data->dbg.fmt = fmt;
        data->dbg.argc = argc;
        memcpy(data->dbg.args, args, argc * sizeof(uintptr_t));
        k_fifo_put(&debug_fifo, data);
    } else {
        printk("I die :(\n");
    }
}
```

## src/debug.h
```c
#ifndef DEBUG_H
#define DEBUG_H

extern volatile bool print_debug_messages;

/*
    This function behaves like printk, but instead of printing directly to serial port, it queues the debug string to be printed
    by the debug task. The formatted string must not exceed 128 characters when included the null character at the end.
*/
void schedule_printk(const char *fmt, size_t argc, uintptr_t *args);

// Schedule printk function to debug task.
#define debug(fmt, ...) \
    if (print_debug_messages) {\
        do {\
            uintptr_t args[] = { __VA_OPT__( (uintptr_t)(__VA_ARGS__) ) };\
            size_t argc = sizeof(args) / sizeof(uintptr_t);\
            schedule_printk(fmt, argc, args);\
        } while (0);\
    }\

struct led_stat_t {
    // Keep track of the toggle amount of this led.
    uint32_t toggled;
};

struct led_stats {
    // Statistics for red led.
    struct led_stat_t red;
    // Statistics for blue led.
    struct led_stat_t blue;
};

struct btn_stat_t {
    // Keep track on how many times a button has been pushed.
    uint32_t pushed;
    // Typical ripple count for this button, aka how many toggles does it make before settling.
    uint32_t typical_ripple;
};

struct btn_stats {
    // Button statistics for manual control button.
    struct btn_stat_t button_manual_toggle;
    // Button statistics for red color toggle button.
    struct btn_stat_t button_red_toggle;
    // Button statistics for yellow color toggle button.
    struct btn_stat_t button_yellow_toggle;
    // Button statistics for green color toggle button.
    struct btn_stat_t button_green_toggle;
    // Button statistics for yellow blink toggle button.
    struct btn_stat_t button_yellow_blink_toggle;    
};

struct thread_stat_t {
    // How long does the thread typically wait for a signal in automatic mode.
    uint64_t typical_signal_wait_time_ms;
    // How long does the thread typically take to finish the task, when it gets a signal.
    uint64_t typical_runtime_ns;
};

struct thread_stats {
    // Main thread statistics.
    struct thread_stat_t main;
    // Red led task thread statistics.
    struct thread_stat_t red;
    // Yellow led task thread statistics.
    struct thread_stat_t yellow;
    // Green led task thread statistics.
    struct thread_stat_t green;
    // UART task thread statistics.
    struct thread_stat_t uart;
    // Dispatcher task thread statistics.
    struct thread_stat_t dispatcher;
    // Debug task thread statistics.
    struct thread_stat_t debug;
};

struct statistics {
    // Statistics of leds.
    struct led_stats leds;
    // Statistics of buttons.
    struct btn_stats btns;
    // Statistics of threads.
    struct thread_stats threads;
};

extern struct statistics statistics;
#endif // DEBUG_H
```

## src/dispatcher.c
```c
/* Uart task waits for data from the UART port and passes*/

#include <zephyr/kernel.h>
#include <zephyr/device.h>
#include <zephyr/drivers/uart.h>
#include <zephyr/timing/timing.h>

#include "ledctl.h"
#include "dispatcher.h"
#include "mux.h"
#include "debug.h"
#include "timeparser.h"

#define STACK_SIZE 512
// Define command sequence size once to deflect possible human errors from not remembering to change every occurance
#define COMSIZ 20
#define UART_DEVICE DT_CHOSEN(zephyr_shell_uart)
const struct device *uart_dev = DEVICE_DT_GET(UART_DEVICE);

K_FIFO_DEFINE(dispatcher_fifo);

K_THREAD_DEFINE(uartth, STACK_SIZE, uart_task, NULL, NULL, NULL, 4, 0, 0);
K_THREAD_DEFINE(dispatchth, STACK_SIZE, dispatcher_task, &color, NULL, NULL, 3, 0, 0);

// Prints the information about usage to the UART shell in command line style
void print_help(void) {
    printk("\n\nUsage:\n\t[[R | Y | G | O]..INT]..[[T]INT]\tSwitch light in given sequence and loop T times\n\n\tUse D to toggle debug on or off (does not echo)\n\n");
};

struct led_control_t {
    int seq_len;
    char colors[COMSIZ];
    uint16_t hold_times[COMSIZ];
    uint16_t loop;
};

struct fifo_data_t {
    void *fifo_reserved;
    struct led_control_t ledctl;
};

bool init_uart(void) {
    if (device_is_ready(uart_dev)) {
        return true;
    }
    debug("UART initialization failed");
    return false;
}

// Helper function to push hold time buffer contents to hold time data array
void push_ht(uint16_t *ht_dat, uint16_t *ht, int *offset, int *len, bool *pd) {
    // Update each corresponding hold time of the sequence
    uint16_t holdfor = *ht;


    while (*len > 0) {
        int ix = *offset;
        ht_dat[ix] = holdfor;
        *offset += 1; // One command handled -> increment the offset
        *len -= 1; // ..and decrement length
    }

    *ht = 1000;
    *pd = false;
}

// Switch to blink state
void simple_task() {
    printk("Timer expired\n");

    state = Blink;
    k_condvar_signal(&ysig);
}

K_TIMER_DEFINE(schedule_timer, simple_task, NULL);

void uart_task(void *, void *, void *) {
    debug("Started uart task");
    // Holds the received single character
    char rechar = 0;
    // Holds the count of received characters from UART and also is the index and seqnt counts the commands in sequence
    int cnt = 0;
    int seqnt = 0;
    bool parsing_digits = false;
    bool uart_print = true;
    // Loop through the given sequence n amount of times
    uint16_t loop = 1;
    bool expect_loop = false;
    // Used to pass the commands and hold times to dispatcher
    char command_buf[COMSIZ];
    uint16_t ht_buf[COMSIZ];
    // Buffer the sequence's hold_time
    // Default to one second
    uint16_t seq_time_buf = 1000;
    // Initialize `command` and `single_command` with zeros
    memset(command_buf, 0, COMSIZ);
    memset(ht_buf, (int)&seq_time_buf, sizeof(ht_buf));

    // Infinitely wait for data to be read from UART
    // ----- Commented out to test time parser uart
    // while (true) {
    //     if (uart_print) {
    //         uart_print = false;
    //         debug("Waiting for UART");
    //     }
    //     // Received a character through UART -> handle it
    //     if (uart_poll_in(uart_dev, &rechar) == 0) {
    //         // To add more complexity for me, the message can have letters R, Y, G, O and optional time as an integer for milliseconds.
    //         // It may contain a sequence of colors and end with the time indicator, in which case the given time is
    //         // used for every color. If the time setting is given, it is applied to colors preceding it.
    //         //
    //         // Example:
    //         // `RYG500R200G500Y1000O` Changes colors Red, Yellow and Green in sequence, holding each on for 500ms.
    //         // Then it holds Red for 200ms, Green for 500ms, Yellow for 1s and finally turns leds off.

    //         // Toggle debug messages on and off but do not print anything.
    //         if (rechar == 'D') {
    //             print_debug_messages = !print_debug_messages;
    //             continue;
    //         }
            
    //         printk("%c", rechar);
    //         if (!paused && state != Manual) {
    //             paused = true;
    //             state = Manual;
    //             cont = color;
    //         }

    //         if (rechar == '\r') {
    //             rechar = '\n';
    //         }
            
    //         // Parse newline aka command end
    //         if (rechar == '\n') {
    //             printk("\n");
    //             push_ht(ht_buf, &seq_time_buf, &cnt, &seqnt, &parsing_digits);
                
    //             debug("Received: %s", command_buf);
    //             // Allocate memory for fifo use
    //             struct fifo_data_t *data = k_malloc(sizeof(struct fifo_data_t));
                
    //             if (data == NULL) {
    //                 debug("Memory allocation error.");
    //                 return;
    //             }
                
    //             memcpy(data->ledctl.colors, command_buf, COMSIZ);
    //             memcpy(data->ledctl.hold_times, ht_buf, sizeof(ht_buf));
    //             data->ledctl.seq_len = cnt;
    //             data->ledctl.loop = loop;
    //             k_fifo_put(&dispatcher_fifo, data);
    //             rechar = 0;
    //             cnt = 0;
    //             seqnt = 0;
    //             memset(command_buf, 0, COMSIZ);
    //             memset(ht_buf, 1000, sizeof(ht_buf));
    //             uart_print = true;
    //             expect_loop = false;
    //             loop = 1;
    //         }
            
    //         // Parse digits
    //         else if (rechar > 47 && rechar < 58) {
    //             if (!parsing_digits) {
    //                 parsing_digits = true;
    //                 seq_time_buf = 0;
    //             }

    //             // Convert to binary integer
    //             if (expect_loop) {
    //                 loop = loop * 10 + (rechar - 48);
    //             } else {
    //                 seq_time_buf = seq_time_buf * 10 + (rechar - 48);
    //             }
    //         }
            
    //         // Parse other characters
    //         else {
    //             // Commands
    //             if ((rechar == 'R' || rechar == 'Y' || rechar == 'G' || rechar == 'O') && !expect_loop) {
    //                 // Write previous sequence time info if present
    //                 if (parsing_digits) {
    //                     push_ht(ht_buf, &seq_time_buf, &cnt, &seqnt, &parsing_digits);
    //                 }
                    
    //                 int index = cnt + seqnt;
    //                 command_buf[index] = rechar;
    //                 seqnt++; // Increment sequence counter
    //                 expect_loop = false;
    //             }

    //             // Parse loop command
    //             else if (rechar == 'T') {
    //                 if (parsing_digits) {
    //                     push_ht(ht_buf, &seq_time_buf, &cnt, &seqnt, &parsing_digits);
    //                 }

    //                 if (expect_loop) {
    //                     debug("\nYou cannot define T multiple times!");
    //                 } else {
    //                     expect_loop = true;
    //                     loop = 0;
    //                 }
    //             }
                
    //             // If no comprehensible command was given or the command was erroneous, print help
    //             else if (rechar != '\r') {
    //                 print_help();
    //                 char discard;
    //                 while (uart_poll_in(uart_dev, &discard) != -1);
    //                 rechar = 0;
    //                 cnt = 0;
    //                 seqnt = 0;
    //                 parsing_digits = false;
    //                 expect_loop = false;
    //                 loop = 1;
    //                 seq_time_buf = 0;
    //                 memset(command_buf, 0, COMSIZ);
    //                 memset(ht_buf, 1000, sizeof(ht_buf));
    //             }
    //         }
    //     }

    //     k_msleep(100);
    // }
    // ----- End comment out

    // This is meant to be a simple implementation to show it has been implemented. I intend to make this implementation better later.
    while (true) {
        if (uart_print) {
            uart_print = false;
            debug("Waiting for UART");
        }
        // Received a character through UART -> handle it
        if (uart_poll_in(uart_dev, &rechar) == 0) {            
            printk("%c", rechar);
            if (!paused && state != Manual) {
                paused = true;
                state = Manual;
                cont = color;
            }

            if (rechar == '\r') {
                rechar = '\n';
            }
            
            // Parse newline aka command end
            if (rechar == '\n') {
                printk("\n");

                int timeout = time_parse(command_buf);
                
                if (timeout > 0) {
                    printk("Setting up timer with %i seconds\n", timeout);
                    k_timer_start(&schedule_timer, K_SECONDS(timeout), K_NO_WAIT);
                } else {
                    printk("Invalid input data. Got error %08x\n", timeout);
                }

                cnt = 0;
                memset(command_buf, 0, COMSIZ);

            } else {
                command_buf[cnt] = rechar;
                cnt++;
            }
        }

        k_msleep(100);
    }
}
                
void dispatcher_task(enum Color *curcol, void *, void *) {
    while (true) {
        debug("Waiting for fifo data");
        struct fifo_data_t *rec_data = k_fifo_get(&dispatcher_fifo, K_FOREVER);

        // Begin counting
        timing_t start = timing_counter_get();

        // Loop through the sequence
        for (int l = 0; l < rec_data->ledctl.loop; l++) {
            
            // Iterate over each command (end with ecountering 0)
            for (int i = 0; i < rec_data->ledctl.seq_len; i++) {
                struct holdtime_t *ht = k_malloc(sizeof(struct holdtime_t));
                memcpy(&ht->time, &rec_data->ledctl.hold_times[i], 2);
                struct k_condvar *ledsig = NULL;
    
                switch (rec_data->ledctl.colors[i]) {
                    case 'R':
                        ledsig = &rsig;
                        debug("Switched led to Red");
                        break;
                    case 'Y':
                        ledsig = &ysig;
                        debug("Switched led to Yellow");
                        break;
                    case 'G':
                        ledsig = &gsig;
                        debug("Switched led to Green");
                        break;
                    case 'O':
                        switch (*curcol) {
                            case Red:
                                ledsig = &rsig;
                                break;
                            case Yellow:
                                ledsig = &ysig;
                                break;
                            case Green:
                                ledsig = &gsig;
                                break;
                            default:
                                ledsig = NULL;
                                debug("Can't turn led off if it is already off.");
                                break;
                        }
    
                        debug("Switched led to Off");
                        break;
                    default:
                        k_oops();
                }
                    
                    // Send the signal if it was set and wait for a generous amount of time for a answer.
                    if (ledsig != NULL) {
                        debug("Waiting for lock to release");
                        if (k_mutex_lock(&lmux, K_MSEC(5000)) == 0) {
                             k_condvar_signal(ledsig);
                            // Wait for minimum hold time to pass before continuing
                            if (k_condvar_wait(&sig_ok, &lmux, K_MSEC(ht->time + HOLD_TIME_MS)) == 0) {
                                // No reason to wait here if we only toggle one color because it holds
                                if (rec_data->ledctl.seq_len > 1) k_msleep(ht->time);
                            } else {
                                debug("Waiting time expired!");
                            }
    
                        } else {
                            debug("Mutex timed out");
                        }
    
                        k_mutex_unlock(&lmux);
                    }
    
                    k_free(ht);
            }
        }

        debug("Dispatcher done! Execution time: %llu ns", timing_cycles_to_ns(timing_counter_get() - start));

        k_free(rec_data);
    }
}
```

## src/dispatcher.h
```c
#ifndef DISPATCHER_H
#define DISPATCHER_H

extern void uart_task(void *, void *, void *);
extern void dispatcher_task(enum Color *, void *, void *);

extern struct k_fifo command_fifo;

bool init_uart(void);

#endif
```

## src/ledctl.c
```c
#include <zephyr/kernel.h>
#include <zephyr/drivers/gpio.h>
#include <zephyr/timing/timing.h>

#include "ledctl.h"
#include "mux.h"
#include "debug.h"

// Set transition time between colors
const uint32_t HOLD_TIME_MS = 1000;
volatile bool paused = false;

// Red and Green are on board leds but yellow needs to be created by combining red and green.
#define RED_L DT_ALIAS(led0)
#define GREEN_L DT_ALIAS(led1)

// Bind to leds and tract their state
static const struct gpio_dt_spec red_led = GPIO_DT_SPEC_GET(RED_L, gpios);
static const struct gpio_dt_spec green_led = GPIO_DT_SPEC_GET(GREEN_L, gpios);

// Current state variables initialized to red
volatile enum State state = Auto;
volatile enum Color cont = Red;
volatile enum Color color = Red;

// Stack size and priority for task threads
#define STACKSIZE 512
#define PRIORITY 2

// TODO: Led tasks should wait for a signal `xsig` locked with led mutex `lmux` and release the lock by giving signal
// to next color or to dispatcher, depending on if mode is automatic or manual. On automatic mode, each task calls the next:
// Red -> Yellow -> Green -> Red.. and on manual mode each task sends a release signal for dispatcher.
// Define tasks for each color
K_THREAD_DEFINE(redth, STACKSIZE,
		red, &state, &color, NULL,
		PRIORITY, 0, 0);

K_THREAD_DEFINE(yellowth, STACKSIZE,
        yellow, &state, &color, NULL,
        PRIORITY, 0, 0);

K_THREAD_DEFINE(greenth, STACKSIZE,
        green, &state, &color, NULL,
        PRIORITY, 0, 0);
        
// Helper functions for tasks
void toggle_led(enum State, enum Color *, enum Color);
void set_red(void);
void set_yellow(void);
void set_green(void);
void set_off(void);
/*
    Add thread execution time on seq_time variable. If ltime_set becomes 7 during this operation, seq_time is scheduled in
    debugging.
*/
void add_or_send_exec(timing_t, int);

/*
    Each led task can set a bit in this atomic variable to signal othre led tasks that it has counted its execution time.

    Other ready tasks won't update the seq_time value until last one to update the value clears the flags.

    Value 7 means that all tasks have added their own values.
*/
atomic_t ltime_set = 0;
atomic_t seq_time = 0;


bool init_leds(void)
{
    // Check that on-board leds are ready
    if (!gpio_is_ready_dt(&red_led) || !gpio_is_ready_dt(&green_led)) {
        debug("Error: LED device(s) not ready");
        return false;
    }

    if (gpio_pin_configure_dt(&red_led, GPIO_OUTPUT_ACTIVE) < 0 ||
        gpio_pin_configure_dt(&green_led, GPIO_OUTPUT_ACTIVE) < 0) {
        debug("Error: Failed to configure LED pins");
        return false;
    }

    return true;
}

void red(enum State *state, enum Color *color, void *)
{
    timing_t start;
    k_sem_give(&threads_ready);

    // Loop forever
    while (1) {
        start = timing_counter_get();
        
        // Wait for a signal to switch led on and off
        debug("Waiting for lmux mutex..");
        k_mutex_lock(&lmux, K_FOREVER);

        debug("Done! Waiting for condition variable rsig..");

        if (k_condvar_wait(&rsig, &lmux, K_FOREVER) == 0) {
            debug("Done!");

            toggle_led(*state, color, Red);
        }

        add_or_send_exec(start, 0);

        k_mutex_unlock(&lmux);
        k_yield();
    }
}

void yellow(enum State *state, enum Color *color, void *)
{
    timing_t start;
    k_sem_give(&threads_ready);    
    // Loop forever
    while (1) {
        start = timing_counter_get();

        // Wait for a signal to switch led on and off
        debug("Waiting for lmux mutex..");
        k_mutex_lock(&lmux, K_FOREVER);

        debug("Done! Waiting for condition variable ysig..");

        if (k_condvar_wait(&ysig, &lmux, K_FOREVER) == 0) {
            debug("Done!");

            if (*state == Blink) {
                while (*state == Blink) {
                    set_yellow();
                    k_msleep(HOLD_TIME_MS);
                    set_off();
                    k_msleep(HOLD_TIME_MS);
                }
            } else {
                toggle_led(*state, color, Yellow);
            }
        }

        add_or_send_exec(start, 1);
        k_mutex_unlock(&lmux);
        k_yield();
    }
}

void green(enum State *state, enum Color *color, void *)
{
    timing_t start;
    k_sem_give(&threads_ready);
    // Loop forever
    while (1) {
        start = timing_counter_get();
        
        // Wait for a signal to switch led on and off
        debug("Waiting for lmux mutex..");
        k_mutex_lock(&lmux, K_FOREVER);
        
        debug("Done! Waiting for condition variable gsig..");
        
        if (k_condvar_wait(&gsig, &lmux, K_FOREVER) == 0) {
            debug("Done!");

            toggle_led(*state, color, Green);
        }

        add_or_send_exec(start, 2);
        k_mutex_unlock(&lmux);
        k_yield();
    }
}

void toggle_led(enum State state, enum Color *from_color, enum Color to_color) {
    // Store the color function to be called and the next led signal if not manual mode
    void (*set_color)(void);
    struct k_condvar *next_led_signal = NULL;

    switch (to_color) {
        case Red:
            set_color = &set_red;
            next_led_signal = &ysig;
            break;
        case Yellow:
            set_color = &set_yellow;
            next_led_signal = &gsig;
            break;
        case Green:
            set_color = &set_green;
            next_led_signal = &rsig;
            break;
        default:
            set_color = &set_off;
            debug("Thread was killed");
            k_oops();
    }

    if (state != Auto) {
        // Toggle off if already on
        if (*from_color == to_color) {
            set_off();
            *from_color = Off;
        } else {
            set_color();
            *from_color = to_color;
        }

        
        // Blink state is handled in the manual_isr in buttons.c
    } else {
        set_color();
        k_msleep(HOLD_TIME_MS);
        k_condvar_signal(next_led_signal);
    }

    k_condvar_signal(&sig_ok);
}

void set_red(void)
{
    gpio_pin_set_dt(&red_led, 1);
    gpio_pin_set_dt(&green_led, 0);
    color = Red;
}

void set_yellow(void)
{
    gpio_pin_set_dt(&red_led, 1);
    gpio_pin_set_dt(&green_led, 1);
    color = Yellow;
}

void set_green(void)
{
    gpio_pin_set_dt(&red_led, 0);
    gpio_pin_set_dt(&green_led, 1);
    color = Green;
}

void set_off(void)
{
    gpio_pin_set_dt(&red_led, 0);
    gpio_pin_set_dt(&green_led, 0);
    color = Off;
}

void add_or_send_exec(timing_t time, int bit) {
    if (!atomic_test_and_set_bit(&ltime_set, bit)) {
        atomic_val_t stop = (atomic_val_t)timing_cycles_to_ns(timing_counter_get() - time);
        atomic_add(&seq_time, stop);
        debug("Thread time: %d ns", stop);

        if (atomic_cas(&ltime_set, 7, 0)) {
            debug("Sequence execution time: %d ns", atomic_clear(&seq_time));
        }
    }
}
```

## src/ledctl.h
```c
#ifndef LEDCTL_H
#define LEDCTL_H

extern const uint32_t HOLD_TIME_MS;
extern volatile bool paused;

// This simplifies the state machine syntax (instead of using integers)
enum State { Auto, Manual, Blink };

// Holds the state of two leds
enum Color { Off, Red, Yellow, Green };

// Current state variables initialized to red
extern volatile enum State state;
extern volatile enum Color cont;
extern volatile enum Color color;

// Red thread
extern const k_tid_t redth;
// Yellow thread
extern const k_tid_t yellowth;
// Green thread
extern const k_tid_t greenth;

bool init_leds(void);

/*
    Set red on, if it is not on. Otherwise set it off.
*/
void red(enum State *state, enum Color *color, void *);

/*
    Set yellow on, if it is not on. Otherwise set it off.
*/
void yellow(enum State *state, enum Color *color, void *);

/*
    Set green on, if it is not on. Otherwise set it off.
*/
void green(enum State *state, enum Color *color, void *);

#endif
```

## src/mux.c
```c
#include <zephyr/kernel.h>

#include "mux.h"

// Define mutex
K_MUTEX_DEFINE(lmux);

// Define signals for each color
K_CONDVAR_DEFINE(rsig);
K_CONDVAR_DEFINE(ysig);
K_CONDVAR_DEFINE(gsig);
K_CONDVAR_DEFINE(sig_ok);

// FIFO for hold time
K_FIFO_DEFINE(ht_fifo);

// Define semaphore for each led task
K_SEM_DEFINE(threads_ready, 0, 3);
```

## src/mux.h
```c
#ifndef MUX_H
#define MUX_H

// Led mutually exclusive lock
extern struct k_mutex lmux;

// Signal for red led
extern struct k_condvar rsig;
// SIgnal for yellow led
extern struct k_condvar ysig;
// Signal for green led
extern struct k_condvar gsig;
// Signal for release
extern struct k_condvar sig_ok;
// Fifo data for hold time
extern struct k_fifo ht_fifo;

// Semaphore to inform main thread that led tasks are ready
extern struct k_sem threads_ready;

struct holdtime_t {
    void *fifo_reserved;
    uint16_t time;
};

extern atomic_t ltime_set;

#endif
```

## src/timeparser.c
```c
#include <zephyr/kernel.h>
#include <ctype.h>
#include "timeparser.h"

// time format: HHMMSS (6 characters)
int time_parse(char *time) {

	// how many seconds, default returns error
	int seconds = 0;
	int len;
	bool iserr = false;

	// Can't do anything else if there is no data to parse
	if (time == NULL) return ERR_TIME(FLAG_TIME_LEN);

	len = strlen(time);
	// Check for length correctness but do not return yet
	if (len != 6) {
		return ERR_TIME(FLAG_TIME_LEN);
		// seconds |= FLAG_TIME_LEN;
	}

	// Check that input contains only digits (ASCII characters between 0x2f and 0x3a exclusive)
	// Parse them simultaneously to integers
	int values[3] = {0, 0, 0};

	for (int i = 0; i < len; i++) {
		if (!isdigit(time[i])) {
			seconds |= FLAG_TIME_SYNTAX;
			if (i < 2) seconds |= FLAG_TIME_VALUE_HOUR;
			else if (i < 4) seconds |= FLAG_TIME_VALUE_MINUTE;
			else if (i < 6) seconds |= FLAG_TIME_VALUE_SECOND;
			else break;

		} else if (i < 6) {
			// Parse the integer and multiply it with ten if it is first
			values[i / 2] += (i & 1) == 0 ? (time[i] - '0') * 10 : time[i] - '0';
		}
	}
	
	if (seconds != 0) iserr = true;

	// More than 59 seconds
	if (values[2] > 59) {
		if (iserr) {
			seconds |= FLAG_TIME_VALUE_SECOND;
		} else {
			seconds = FLAG_TIME_VALUE_SECOND;
			iserr = true;
		}
	}

	// More than 59 minutes
	if (values[1] > 59) {
		if (iserr) {
			seconds |= FLAG_TIME_VALUE_MINUTE;
		} else {
			seconds = FLAG_TIME_VALUE_MINUTE;
			iserr = true;
		}
	}

	// More than 23 hours
	if (values[0] > 23) {
		if (iserr) {
			seconds |= FLAG_TIME_VALUE_HOUR;
		} else {
			seconds = FLAG_TIME_VALUE_HOUR;
			iserr = true;
		}
	}

	// Return error flags or seconds
	return iserr ? ERR_TIME(seconds) : values[0] * 3600 + values[1] * 60 + values[2];
}
```

## src/timeparser.h
```c
#ifndef TIMEPARSER_H
#define TIMEPARSER_H

// Return codes and flags to signal multiple errors so the user can try to correct all of them

// Return value for correctly parsed time string (Unused)
#define TIME_OK                   0

// Signals that the parsed time string has incorrect length
#define FLAG_TIME_LEN             1
// Signals that the parsed time string has invalid characters
#define FLAG_TIME_SYNTAX          2
// Signals that the parsed time string has invalid hour field
#define FLAG_TIME_VALUE_HOUR      4
// Signals that the parsed time string has invalid minute field
#define FLAG_TIME_VALUE_MINUTE    8
// Signals that the parsed time string has invalid seconds field
#define FLAG_TIME_VALUE_SECOND   16

// Convert OR'd flags into error. Keeps syntax and intent clear.
#define ERR_TIME(flags) (-(flags))

int time_parse(char *time);

#endif
```
